#include <Adafruit_GFX.h>
#include <Adafruit_SSD1306.h>
#include <Wire.h>

#define SCREEN_WIDTH 128
#define SCREEN_HEIGHT 64
#define OLED_RESET -1
#define SCREEN_ADDRESS 0x3C

Adafruit_SSD1306 display(SCREEN_WIDTH, SCREEN_HEIGHT, &Wire, OLED_RESET);

const int16_t LOGO_WIDTH = 32;
const int16_t LOGO_HEIGHT = 32;
const unsigned char LOGO_BITMAP[] PROGMEM = {
  0xff, 0xff, 0xff, 0xff,
  0xff, 0xff, 0xff, 0xff,
  0xc0, 0x00, 0x00, 0x03,
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  0xff, 0xff, 0xff, 0xff
};

const int16_t MOVE_STEP = 2;

int16_t logoX = 0;
int16_t logoY = 0;
int16_t velX = MOVE_STEP;
int16_t velY = MOVE_STEP;

void setup() {
  Serial.begin(9600);
  Serial.println(F("Starting SSD1306 demo"));

  if (!display.begin(SSD1306_SWITCHCAPVCC, SCREEN_ADDRESS)) {
    Serial.println(F("SSD1306 allocation failed"));
    for (;;)
      ;  // Don't proceed, loop forever.
  }
}

void loop() {
  display.clearDisplay();
  display.drawBitmap(logoX, logoY, LOGO_BITMAP, LOGO_WIDTH, LOGO_HEIGHT, WHITE);
  display.display();

  logoX += velX;
  logoY += velY;

  if (logoX <= 0 || logoX + LOGO_WIDTH >= SCREEN_WIDTH) {
    velX = -velX;
    logoX = constrain(logoX, 0, SCREEN_WIDTH - LOGO_WIDTH);
  }
  if (logoY <= 0 || logoY + LOGO_HEIGHT >= SCREEN_HEIGHT) {
    velY = -velY;
    logoY = constrain(logoY, 0, SCREEN_HEIGHT - LOGO_HEIGHT);
  }

  delay(30);
}
